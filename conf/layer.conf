## conf/layer.conf
```bitbake
# We have a conf and classes directory, add to BBPATH
BBPATH .= ":${LAYERDIR}"

# We have recipes-* directories, add to BBFILES
BBFILES += "${LAYERDIR}/recipes-*/*/*.bb \
            ${LAYERDIR}/recipes-*/*/*.bbappend"

BBFILE_COLLECTIONS += "meta-drabina"
BBFILE_PATTERN_meta-drabina = "^${LAYERDIR}/"
BBFILE_PRIORITY_meta-drabina = "6"

LAYERDEPENDS_meta-drabina = "core"
LAYERSERIES_COMPAT_meta-drabina = "kirkstone"
```
